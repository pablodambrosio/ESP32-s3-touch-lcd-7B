## sdkconfig.defaults
```kconfig
# Target & Flash
CONFIG_IDF_TARGET="esp32s3"
CONFIG_ESPTOOLPY_FLASHSIZE_16MB=y
CONFIG_ESPTOOLPY_FLASHMODE_QIO=y
CONFIG_ESPTOOLPY_FLASHFREQ_80M=y

# CPU Frequency
CONFIG_ESP_DEFAULT_CPU_FREQ_MHZ_240=y

# 8MB Octal PSRAM @ 80MHz
CONFIG_SPIRAM=y
CONFIG_SPIRAM_MODE_OCT=y
CONFIG_SPIRAM_SPEED_80M=y
CONFIG_SPIRAM_XIP_FROM_PSRAM=y
CONFIG_SPIRAM_FETCH_INSTRUCTIONS=y
CONFIG_SPIRAM_RODATA=y

# Cache & Memory
CONFIG_ESP32S3_DATA_CACHE_LINE_64B=y

# RGB LCD Driver Stability (ESP-IDF v5/v6)
CONFIG_LCD_RGB_ISR_IRAM_SAFE=y
CONFIG_LCD_RGB_RESTART_IN_VSYNC=y

# FreeRTOS Tick Rate (1000 Hz for accurate frame pacing)
CONFIG_FREERTOS_HZ=1000

# Compiler Optimization for Performance
CONFIG_COMPILER_OPTIMIZATION_PERF=y
```
